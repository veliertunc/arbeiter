## apps/esp32/main/Kconfig.projbuild
```kconfig
menu "Arbeiter ESP32 User Admin"

config APP_LCD_MOSI_GPIO
    int "Shared SPI MOSI GPIO"
    range 0 39
    default 23

config APP_LCD_MISO_GPIO
    int "Shared SPI MISO GPIO"
    range 0 39
    default 19

config APP_LCD_SCLK_GPIO
    int "Shared SPI clock GPIO"
    range 0 39
    default 18

config APP_SD_CS_GPIO
    int "SD card chip-select GPIO"
    range 0 39
    default 5

config APP_LCD_CS_GPIO
    int "ILI9341 chip-select GPIO"
    range 0 39
    default 15

config APP_LCD_DC_GPIO
    int "ILI9341 data/command GPIO"
    range 0 39
    default 2

config APP_LCD_RST_GPIO
    int "ILI9341 reset GPIO"
    range -1 39
    default 4
    help
        Set to -1 when the display module does not expose reset.

config APP_LCD_BACKLIGHT_GPIO
    int "TFT backlight GPIO"
    range -1 39
    default 32
    help
        Set to -1 when the backlight is permanently wired on.

config APP_LCD_BACKLIGHT_ACTIVE_LOW
    bool "Backlight is active low"
    default n

config APP_TOUCH_CS_GPIO
    int "XPT2046 chip-select GPIO"
    range 0 39
    default 33

config APP_TOUCH_IRQ_GPIO
    int "XPT2046 PENIRQ GPIO (-1 for polling only)"
    range -1 39
    default 34

config APP_TOUCH_SWAP_XY
    bool "Swap touch X and Y axes"
    default n

config APP_TOUCH_MIRROR_X
    bool "Mirror touch X axis"
    default n

config APP_TOUCH_MIRROR_Y
    bool "Mirror touch Y axis"
    default n

endmenu
```

## apps/esp32/sdkconfig.defaults
```kconfig
CONFIG_IDF_TARGET="esp32"
CONFIG_LV_COLOR_DEPTH_16=y
CONFIG_LV_COLOR_DEPTH=16
CONFIG_LV_FONT_MONTSERRAT_12=y
CONFIG_LV_FONT_MONTSERRAT_16=y
CONFIG_LV_FONT_MONTSERRAT_18=y
CONFIG_LV_USE_DROPDOWN=y
CONFIG_LV_USE_KEYBOARD=y
CONFIG_LV_USE_TEXTAREA=y
```
